## boards/arm/corne/Kconfig.board
```kconfig
#
# Copyright (c) 2024 The ZMK Contributors
# SPDX-License-Identifier: MIT
#

config BOARD_CORNE_LEFT
    bool "corne left"
    depends on SOC_NRF52840_QIAA

config BOARD_CORNE_RIGHT
    bool "corne right"
    depends on SOC_NRF52840_QIAA
```
