## boards/lmilojevicc/corne/board.yml
```yaml
boards:
  - name: corne_left
    vendor: lmilojevicc
    socs:
      - name: nrf52840
        variants:
          - name: zmk
  - name: corne_right
    vendor: lmilojevicc
    socs:
      - name: nrf52840
        variants:
          - name: zmk
```

## config/west.yml
```yaml
manifest:
  remotes:
    - name: zmkfirmware
      url-base: https://github.com/zmkfirmware
    - name: m165437
      url-base: https://github.com/M165437
    # - name: mctechnology17
    #   url-base: https://github.com/mctechnology17
  projects:
    - name: zmk
      remote: zmkfirmware
      revision: main
      import: app/west.yml
    - name: nice-view-gem
      remote: m165437
      revision: main
    # - name: zmk-nice-oled
    #   remote: mctechnology17
    #   revision: main
  self:
    path: config
```
